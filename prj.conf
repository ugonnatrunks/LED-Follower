## CMakeLists.txt
```
cmake_minimum_required(VERSION 3.20.0)
find_package(Zephyr REQUIRED HINTS $ENV{ZEPHYR_BASE})

project(m2-led-follower-ugonnatrunks)

target_include_directories(app PRIVATE include)

target_sources(app PRIVATE 
    src/main.c
    src/led_blink_patterns.c
    src/led_button_initializations.c
    src/state_machines.c
)
```

## prj.conf
```kconfig
CONFIG_SMF=y
CONFIG_GPIO=y
CONFIG_EVENTS=y
```

## src/main.c
```c
#include "app_config.h"

int main(void)
{
        while (true) {
                k_msleep(SLEEP_TIME);
        }
        return 0;
}
```

## include/app_config.h
```c
#ifndef _APP_CONFIG_
#define _APP_CONFIG_

#include <stdio.h>
#include <zephyr/smf.h> 
#include <zephyr/kernel.h>
#include <zephyr/device.h>
#include <zephyr/devicetree.h>
#include <zephyr/sys/printk.h>
#include <zephyr/drivers/gpio.h>

#define SLEEP_TIME                                  2000
#define MY_STACK_SIZE                               1024
#define MY_PRIORITY                                 5
#define HIGH_PRIORITY                               3

#define SHORT_PAUSE                                 50
#define MEDIUM_PAUSE                                100
#define LONG_PAUSE                                  800
#define INDICATOR_PAUSE                             500
#define INDEX_OF_STATES                             2
#define WAIT_TO_CLEAR_MESSAGE                       1500

#define NORMAL_RATE                                 1
#define FAST_RATE                                   3
#define SLOW_RATE                                   2

int blink_rate_get(void);
void blink_rate_set(int rate);
extern int blink_rate_multiplier;
int blink_pattern_rate_get(int f_rate, int blink_rate_multiplier);

extern const struct gpio_dt_spec LED2;
extern const struct gpio_dt_spec LED4;
extern const struct gpio_dt_spec BUTTON2;
extern const struct gpio_dt_spec BUTTON4;

extern struct k_mutex LED2_mutex;
extern struct k_event BUTTON2_Pressed_Event;
extern struct k_event BUTTON4_Pressed_Event;

#define BUTTON2_EVENT_BIT                           BIT(0)
#define BUTTON2_PATTERN1_BIT                        BIT(1)
#define BUTTON2_PATTERN2_BIT                        BIT(2)
#define BUTTON2_PATTERN3_BIT                        BIT(3)
#define BUTTON4_EVENT_BIT                           BIT(0)
#define RESET_BIT                                   BIT(4)

void ISRs_Thread(void *p1, void *p2, void *p3);
void patterns_on_LED2(void *p1, void *p2, void *p3);
void GPIO_initializations(void *p1, void *p2, void *p3);
void button2_event_handler(void *p1, void *p2, void *p3);
void button4_event_handler(void *p1, void *p2, void *p3);
void default_time_indicator(void *p1, void *p2, void *p3);

void time_indicator_pattern(void);
void blink_pattern1(int blink_rate_multiplier);
void blink_pattern2(int blink_rate_multiplier);
void blink_pattern3(int blink_rate_multiplier);

// -----------------------------
// Logic Levels and Booleans
// -----------------------------
#define ON              (1u)
#define OFF             (0u)

#define TRUE            (1u)
#define FALSE           (0u)

#define ENABLED         (1u)
#define DISABLED        (0u)

#define HIGH            (1u)
#define LOW             (0u)

#endif
```

## src/GPIO_initializations.c
```c
#include "app_config.h"
K_THREAD_DEFINE(GPIO_initializations_id, MY_STACK_SIZE, GPIO_initializations, NULL, NULL, NULL, HIGH_PRIORITY, 0, 0);

const struct gpio_dt_spec BUTTON2 = GPIO_DT_SPEC_GET(DT_NODELABEL(button1), gpios);
const struct gpio_dt_spec BUTTON4 = GPIO_DT_SPEC_GET(DT_NODELABEL(button3), gpios);
const struct gpio_dt_spec LED2 = GPIO_DT_SPEC_GET(DT_NODELABEL(led1), gpios);
const struct gpio_dt_spec LED4 = GPIO_DT_SPEC_GET(DT_NODELABEL(led3), gpios);

int ret;

void GPIO_initializations(void *p1, void *p2, void *p3) {

if ((!gpio_is_ready_dt(&BUTTON2)) || (!gpio_is_ready_dt(&BUTTON4)) || (!gpio_is_ready_dt(&LED2)) || (!gpio_is_ready_dt(&LED4))) {
    printk("A GPIO is not ready!\n");
}

if ((gpio_pin_configure_dt(&BUTTON2, GPIO_INPUT)) || (gpio_pin_configure_dt(&BUTTON4, GPIO_INPUT)) 
    || (gpio_pin_configure_dt(&LED2, GPIO_OUTPUT)) || (gpio_pin_configure_dt(&LED4, GPIO_OUTPUT))) {
        printk("A GPIO pin was not successfully configured!\n");
    }

if ( (gpio_pin_interrupt_configure_dt(&BUTTON2, GPIO_INT_EDGE_TO_INACTIVE)) || (gpio_pin_interrupt_configure_dt(&BUTTON4, GPIO_INT_EDGE_TO_INACTIVE))) {
        printk("GPIO Interrupt to successfully configured!\n");
    }
}
```

## src/led_blink_patterns.c
```c
#include "app_config.h"

// Short-on / Long-off
void blink_pattern3(int blink_rate_multiplier) {
    gpio_pin_set_dt(&LED2, 1);
    k_msleep(blink_pattern_rate_get(MEDIUM_PAUSE, blink_rate_multiplier));
    gpio_pin_set_dt(&LED2, 0);
    k_msleep(blink_pattern_rate_get(LONG_PAUSE, blink_rate_multiplier));
}
// Heartbeat Blink (Double Pulse)
void blink_pattern1(int blink_rate_multiplier) {
    gpio_pin_set_dt(&LED2, 1);
    k_msleep(blink_pattern_rate_get(SHORT_PAUSE, blink_rate_multiplier));
    gpio_pin_set_dt(&LED2, 0);
    k_msleep(blink_pattern_rate_get(MEDIUM_PAUSE, blink_rate_multiplier));
    gpio_pin_set_dt(&LED2, 1);
    k_msleep(blink_pattern_rate_get(SHORT_PAUSE, blink_rate_multiplier));
    gpio_pin_set_dt(&LED2, 0);
    k_msleep(blink_pattern_rate_get(LONG_PAUSE, blink_rate_multiplier));
}

// Blink-Hold (Activity + Ready Indicator)
void blink_pattern2(int blink_rate_multiplier) {
    gpio_pin_set_dt(&LED2, 1);
    k_msleep(blink_pattern_rate_get(MEDIUM_PAUSE, blink_rate_multiplier));
    gpio_pin_set_dt(&LED2, 0);
    k_msleep(blink_pattern_rate_get(MEDIUM_PAUSE, blink_rate_multiplier));
    gpio_pin_set_dt(&LED2, 1);
    k_msleep(blink_pattern_rate_get(MEDIUM_PAUSE, blink_rate_multiplier));
    gpio_pin_set_dt(&LED2, 0);
    k_msleep(blink_pattern_rate_get(MEDIUM_PAUSE, blink_rate_multiplier));
    gpio_pin_set_dt(&LED2, 1);
    k_msleep(blink_pattern_rate_get(INDICATOR_PAUSE, blink_rate_multiplier));
    gpio_pin_set_dt(&LED2, 0);
    k_msleep(blink_pattern_rate_get(INDICATOR_PAUSE, blink_rate_multiplier));
}

// Blink to give a sense of time
void time_indicator_pattern(void) {
    gpio_pin_set_dt(&LED4, 1);
    k_msleep(INDICATOR_PAUSE);
    gpio_pin_set_dt(&LED4, 0);
    k_msleep(INDICATOR_PAUSE);
}

// Functions for safely managing the blink rate multiplier
void blink_rate_set(int rate) {
    k_mutex_lock(&LED2_mutex, K_FOREVER);
    blink_rate_multiplier = rate;
    k_mutex_unlock(&LED2_mutex);
}

int blink_rate_get(void) {
    k_mutex_lock(&LED2_mutex, K_FOREVER);
    float rate = blink_rate_multiplier;
    k_mutex_unlock(&LED2_mutex);
    return rate;
}

// Preparing the blink rate for use by the main pattern functions
int blink_pattern_rate_get(int pause, int blink_rate_multiplier) {
    int pause_time = pause;
    if (blink_rate_multiplier > 2) {
        pause_time /= 2;
        return pause_time;
    } else {
        pause_time *= blink_rate_multiplier;
        return pause_time;
    }
}
```

## src/threads_events_isr.c
```c
#include "app_config.h"

K_MUTEX_DEFINE(LED2_mutex);
K_EVENT_DEFINE(BUTTON2_Pressed_Event);
K_EVENT_DEFINE(BUTTON4_Pressed_Event);

int blink_rate_multiplier = NORMAL_RATE;
static int i = 0;
static int idx = 1;

/*************************Thread running LED4 to give a sense of time**********************************/
K_THREAD_DEFINE(LED4_Patterns_id, MY_STACK_SIZE, default_time_indicator, NULL, NULL, NULL, MY_PRIORITY, 0, 0);
void default_time_indicator(void *p1, void *p2, void *p3) {
    while (true) {
        time_indicator_pattern();
        k_yield();
    }
}

/*************************Thread running the three patterns on LED2*****************************************/
K_THREAD_DEFINE(LED2_Patterns_id, MY_STACK_SIZE, patterns_on_LED2, NULL, NULL, NULL, MY_PRIORITY, 0, 0);
void patterns_on_LED2(void *p1, void *p2, void *p3) {
    static int use_blink_rate;
    uint32_t event_holder;

    while (true) {
        use_blink_rate = blink_rate_get();
        event_holder = k_event_test(&BUTTON2_Pressed_Event, BUTTON2_PATTERN1_BIT | BUTTON2_PATTERN2_BIT | BUTTON2_PATTERN3_BIT);
        if ( (k_event_test(&BUTTON2_Pressed_Event, BUTTON2_PATTERN1_BIT)) == FALSE) {
            blink_pattern1(use_blink_rate);
            printk("\033[1;1HPattern 1 Executing!");
        }
        else if ( (k_event_test(&BUTTON2_Pressed_Event, BUTTON2_PATTERN2_BIT | BUTTON2_PATTERN1_BIT)) == (BUTTON2_PATTERN2_BIT | BUTTON2_PATTERN1_BIT)) {
            blink_pattern2(use_blink_rate);
            printk("\033[1;1HPattern 2 Executing!");
        }
        else if ( (k_event_test(&BUTTON2_Pressed_Event, BUTTON2_PATTERN3_BIT)) == BUTTON2_PATTERN3_BIT) {
            blink_pattern3(use_blink_rate);
            printk("\033[1;1HPattern 3 Executing!");
        }
    }
}

/*************************Button2 Pressed ISR/Event********************************************************/
void button2_pressed(const struct device *dev, struct gpio_callback *cb, uint32_t pins) 
{
    k_event_post(&BUTTON2_Pressed_Event, BUTTON2_EVENT_BIT);
}

/*************************Button4 Pressed ISR/Event********************************************************/
void button4_pressed(const struct device *dev, struct gpio_callback *cb, uint32_t pins) 
{
    k_event_post(&BUTTON4_Pressed_Event, BUTTON4_EVENT_BIT);
} 

/*************************Button ISR Initializations********************************************************/
K_THREAD_DEFINE(ISRs_thread_id, MY_STACK_SIZE, ISRs_Thread, NULL, NULL, NULL, MY_PRIORITY, 0, 0);
void ISRs_Thread(void *p1, void *p2, void *p3) {
    static struct gpio_callback button2_cb;
    gpio_init_callback(&button2_cb, button2_pressed, BIT(BUTTON2.pin));
    gpio_add_callback(BUTTON2.port, &button2_cb);

    static struct gpio_callback button4_cb;
    gpio_init_callback(&button4_cb, button4_pressed, BIT(BUTTON4.pin));
    gpio_add_callback(BUTTON4.port, &button4_cb);
}

/*************************Button2 Event handler thread*************************************************************/
K_THREAD_DEFINE(LED2_Pattern_Events_id, MY_STACK_SIZE, button2_event_handler, NULL, NULL, NULL, MY_PRIORITY, 0, 0);
void button2_event_handler(void *p1, void *p2, void *p3) {

    while (true) {
        uint32_t button_event = k_event_wait(&BUTTON2_Pressed_Event, BUTTON2_EVENT_BIT, false, K_FOREVER);
        if (button_event & BUTTON2_EVENT_BIT) {
            k_msleep(50);
            printk("\033[2;1HButton 2 Pressed, Pattern Changed!");
            switch (idx) {
            case 1:
                idx++;
                k_event_post(&BUTTON2_Pressed_Event, BUTTON2_PATTERN1_BIT | BUTTON2_PATTERN2_BIT);
                k_event_set_masked(&BUTTON2_Pressed_Event, LOW, BUTTON2_EVENT_BIT);
                k_msleep(WAIT_TO_CLEAR_MESSAGE);
                printk("\033[2;1H\033[2K");
                continue;
            case 2:
                idx++;
                k_event_set_masked(&BUTTON2_Pressed_Event, LOW, BUTTON2_PATTERN2_BIT);
                k_event_post(&BUTTON2_Pressed_Event, BUTTON2_PATTERN3_BIT);
                k_event_set_masked(&BUTTON2_Pressed_Event, LOW, BUTTON2_EVENT_BIT);
                k_msleep(WAIT_TO_CLEAR_MESSAGE);
                printk("\033[2;1H\033[2K"); 
                continue;           
            case 3:
                idx = 1;
                k_event_set_masked(&BUTTON2_Pressed_Event, LOW, BUTTON2_PATTERN1_BIT | BUTTON2_PATTERN2_BIT | BUTTON2_PATTERN3_BIT);
                k_event_set_masked(&BUTTON2_Pressed_Event, LOW, BUTTON2_EVENT_BIT);
                k_msleep(WAIT_TO_CLEAR_MESSAGE);
                printk("\033[2;1H\033[2K");
                continue;
            }
        }
    }  
}

/*************************Button4 Event handler thread*************************************************************/
K_THREAD_DEFINE(LED4_Pattern_Events_id, MY_STACK_SIZE, button4_event_handler, NULL, NULL, NULL, MY_PRIORITY, 0, 0);
void button4_event_handler(void *p1, void *p2, void *p3) {
    int rates[3] = { FAST_RATE, NORMAL_RATE, SLOW_RATE };

    while (true) {
        uint32_t button_event = k_event_wait(&BUTTON4_Pressed_Event, BUTTON4_EVENT_BIT, true, K_FOREVER);
        if (button_event & BUTTON4_EVENT_BIT) {
            k_msleep(50);
            if (i < INDEX_OF_STATES) {
                i++;
                blink_rate_set(rates[i]);
            } else {
                i = 0;
                blink_rate_set(rates[i]);
            }
        }
        printk("\033[2;1HButton 4 Pressed, Rate Changed!");
        k_msleep(WAIT_TO_CLEAR_MESSAGE);
        printk("\033[2;1H\033[2K");
    }
}
```
